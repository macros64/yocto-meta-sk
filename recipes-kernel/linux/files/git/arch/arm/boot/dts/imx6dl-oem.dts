/*
 * Copyright 2014 starterkit.ru
 *
 * The code contained herein is licensed under the GNU General Public
 * License V2.
 */

/dts-v1/;

#include "imx6dl.dtsi"
#include "imx6qdl-oem.dtsi"

/ {
	model = "Starterkit SK-iMX6-OEM Board";
	compatible = "sk,imx6dl-oem", "fsl,imx6dl-sabresd", "fsl,imx6dl";

	memory {
		reg = <0x10000000 0x20000000>;
	};
};

&mxcfb1 {
	status = "okay";
};

&mxcfb2 {
	status = "okay";
};
